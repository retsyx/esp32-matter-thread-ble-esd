## main/Kconfig.projbuild
```kconfig
menu "Example Configuration"

    config BOARD_XIAO_ESP32C6
        bool "Use the XIAO ESP32-C6 carrier board"
        depends on IDF_TARGET_ESP32C6
        default n
        help
            Select the carrier in hw/board: BMA400 SDA on GPIO22 (D4),
            SCL on GPIO23 (D5), and INT1 on GPIO2 (D2). Battery voltage
            is measured through a 1:1 divider on GPIO1 (D1 / ADC1 CH1).
            Also enables the XIAO onboard antenna using GPIO3 and GPIO14.
            Leave disabled for the original SparkFun Qwiic Pocket wiring.

    config SHTC3_I2C_SDA_PIN
        int "I2C SDA Pin"
        default 4
        help
            GPIO number for I2C master data

    config SHTC3_I2C_SCL_PIN
        int "I2C SCL Pin"
        default 5
        help
            GPIO number for I2C master clock

    config PIR_DATA_PIN
        int "PIR Data Pin"
        default 7
        help
            Default PIR Data Pin

endmenu
```
